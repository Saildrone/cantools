VERSION ""

NS_ :

BS_:

BU_:

BO_ 10 PersonName: 40 Vector___XXX
 SG_ first_name : 0|160@1+ (1,0) [0|0] "String" Vector__XXX
 SG_ last_name : 160|160@1+ (1,0) [0|0] "str" Vector__XXX
